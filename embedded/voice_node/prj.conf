## CMakeLists.txt
```
cmake_minimum_required(VERSION 3.20.0)
find_package(Zephyr REQUIRED HINTS $ENV{ZEPHYR_BASE})
project(voice_node)

target_sources(app PRIVATE src/main.c)
```

## prj.conf
```kconfig
# voice_node — Seeed XIAO ESP32S3 Sense
# Milestone 1: WiFi + TLS + WebSocket connectivity
#
# Build:  west build -b xiao_esp32s3 .
# Flash:  west flash  (run on host, not inside container)

# ── WiFi ──────────────────────────────────────────────────────────────────────
# CONFIG_WIFI=y auto-selects the ESP32 WiFi driver via devicetree.
# CONFIG_ESP32_WIFI and CONFIG_NET_L2_WIFI don't exist in Zephyr 4.x.
# CONFIG_WIFI=y
# CONFIG_NET_L2_WIFI_MGMT=y

# ── Networking ────────────────────────────────────────────────────────────────
# CONFIG_NET_SOCKETS_POSIX_NAMES removed in Zephyr 4.x — always enabled.
# CONFIG_NETWORKING=y
# CONFIG_NET_IPV4=y
# CONFIG_NET_TCP=y
# CONFIG_NET_SOCKETS=y
# CONFIG_DNS_RESOLVER=y

# ── TLS ───────────────────────────────────────────────────────────────────────
# CONFIG_MBEDTLS=y
# CONFIG_NET_SOCKETS_SOCKOPT_TLS=y
# CONFIG_NET_SOCKETS_TLS_MAX_CONTEXTS=4

# ── WebSocket ─────────────────────────────────────────────────────────────────
# CONFIG_WEBSOCKET_CLIENT=y
# CONFIG_HTTP_CLIENT=y

# ── PSRAM (external 8MB — required for TLS + audio buffers) ───────────────────
# CONFIG_ESP_SPIRAM=y

# ── GPIO ──────────────────────────────────────────────────────────────────────
CONFIG_GPIO=y

# ── Shell ─────────────────────────────────────────────────────────────────────
# Interactive shell over the same UART as the console. Built-in commands:
# kernel, net, wifi, log — useful for runtime inspection without reflashing.
CONFIG_SHELL=y
CONFIG_SHELL_BACKEND_SERIAL=y

# ── Logging over USB Serial/JTAG (built into ESP32S3, no USB stack needed) ────
# The ESP32S3 routes UART0 over USB-C natively via the USB Serial/JTAG
# peripheral. CONFIG_LOG_BACKEND_UART sends output there automatically.
CONFIG_UART_CONSOLE=y
CONFIG_LOG=y
CONFIG_LOG_BACKEND_UART=y
CONFIG_LOG_DEFAULT_LEVEL=3

# ── WiFi credentials (do not commit — use credentials.conf) ───────────────────
# CONFIG_WIFI_SSID="YourNetwork"
# CONFIG_WIFI_PSK="YourPassword"
```

## src/main.c
```c
#include <zephyr/kernel.h>
#include <zephyr/logging/log.h>
#include <zephyr/drivers/gpio.h>

LOG_MODULE_REGISTER(voice_node, LOG_LEVEL_DBG);

#define LED0_NODE DT_ALIAS(led0)
static const struct gpio_dt_spec led = GPIO_DT_SPEC_GET(LED0_NODE, gpios);

int main(void)
{
	LOG_INF("voice_node starting");

	if (!gpio_is_ready_dt(&led)) {
		LOG_ERR("LED GPIO not ready");
		return -1;
	}

	gpio_pin_configure_dt(&led, GPIO_OUTPUT_ACTIVE);
	LOG_INF("LED blinking — application mode");

	while (1) {
		gpio_pin_toggle_dt(&led);
		k_sleep(K_MSEC(500));
	}

	return 0;
}
```
