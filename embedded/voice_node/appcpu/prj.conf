## CMakeLists.txt
```
cmake_minimum_required(VERSION 3.20.0)
find_package(Zephyr REQUIRED HINTS $ENV{ZEPHYR_BASE})
project(voice_node_appcpu)

target_sources(app PRIVATE
    src/main.c
    src/pdm.c
    src/play.c
)
target_include_directories(app PRIVATE ${CMAKE_CURRENT_SOURCE_DIR}/../common)
```

## prj.conf
```kconfig
# voice_node appcpu — APP CPU (Core 1) image
# Runs on xiao_esp32s3/esp32s3/appcpu
#
# No console on this core. Log output is forwarded to procpu via IPM channel 1
# and printed there with a [C1] prefix. See src/main.c:ipm_log().

# ── IPC (inter-processor communication — APP CPU ↔ PRO CPU) ──────────────────
CONFIG_IPM=y

# ── I2S — PDM microphone (MSM261S4030H0R, GPIO41/42) ─────────────────────────
# DMA is required by the ESP32 I2S driver (uses DMA channels 2/3 for RX/TX)
CONFIG_DMA=y
CONFIG_I2S=y
CONFIG_GPIO=y

# ── I2S TX (speaker playback) tuning ─────────────────────────────────────────
# When the driver's internal TX queue empties between blocks, the ISR starts a
# timer.  At 0 ms (default) the timer fires before the producer thread can
# refill the queue, triggering state=ERROR and permanently stopping the DMA.
# 10 ms gives the thread enough runway to write the next block safely.
CONFIG_I2S_ESP32_ALLOWED_EMPTY_TX_QUEUE_DEFERRAL_TIME_MS=10

# ── PSRAM — shared audio buffer (procpu inits hardware; appcpu needs cache) ──
CONFIG_ESP_SPIRAM=y
CONFIG_SPIRAM_MODE_OCT=y

# ── Stack / heap ──────────────────────────────────────────────────────────────
# 6KB: I2S read + mono-strip memcpy + IPM callbacks (SD/FAT write moved to procpu)
CONFIG_MAIN_STACK_SIZE=6144
CONFIG_HEAP_MEM_POOL_SIZE=2048
```

## src/main.c
```c
/*
 * appcpu — APP CPU (Core 1)
 *
 * Owns all I2S/DMA on the ESP32-S3:
 *   I2S0 — PDM mic capture (MSM261S4030H0R)
 *   I2S1 — TTS WAV playback (MAX98357A, Milestone 4)
 *
 * Keeping both I2S peripherals on one core avoids cross-core GDMA hardware
 * conflicts: procpu's GDMA global init corrupts appcpu's I2S0 setup when
 * procpu also enables an I2S driver.
 *
 * IPM message IDs (shared with procpu/src/main.c):
 *   id=0  appcpu → procpu   log string
 *   id=1  procpu → appcpu   command: uint8_t 1=start, 0=stop
 *   id=2  appcpu → procpu   done:    signal only (byte_count lives in struct audio_shared)
 *   id=3  procpu → appcpu   buf_addr: uint32_t address of audio_psram_buf
 *   id=4  procpu → appcpu   play:    struct ipm_play_msg {addr, len} — WAV in PSRAM
 */

#include <zephyr/kernel.h>
#include <zephyr/drivers/ipm.h>
#include <zephyr/device.h>
#include <stdint.h>
#include <string.h>
#include <stdio.h>
#include <stdarg.h>
#include "pdm.h"
#include "play.h"
#include "ipm_ids.h"

static const struct device *ipm_dev;

static volatile bool     recording    = false;
static volatile bool     stop_pending = false;
static volatile uint32_t audio_buf_addr = 0;

static volatile bool     play_pending  = false;
static volatile uint32_t play_buf_addr = 0;

#define APPCPU_LOOPBACK_USE_TEST_TONE 1

static void ipm_log(const char *fmt, ...)
{
	char buf[128];
	va_list args;

	va_start(args, fmt);
	vsnprintf(buf, sizeof(buf), fmt, args);
	va_end(args);

	ipm_send(ipm_dev, 1, IPM_ID_LOG, buf, strlen(buf) + 1);
}

static void ipm_rx_cb(const struct device *dev, void *ctx,
		      uint32_t id, volatile void *data)
{
	ARG_UNUSED(dev);
	ARG_UNUSED(ctx);

	if (id == IPM_ID_CMD) {
		uint8_t cmd = *(volatile uint8_t *)data;

		if (cmd == CMD_START && !recording) {
			recording    = true;
			stop_pending = false;
		} else if (cmd == CMD_STOP && recording) {
			stop_pending = true;
		}
	} else if (id == IPM_ID_BUFADDR) {
		audio_buf_addr = *(volatile uint32_t *)data;
	} else if (id == IPM_ID_PLAYBUFADDR) {
		play_buf_addr = *(volatile uint32_t *)data;
	} else if (id == IPM_ID_PLAY) {
		play_pending = true;
	}
}

int main(void)
{
	ipm_dev = DEVICE_DT_GET(DT_NODELABEL(ipm0));
	if (!device_is_ready(ipm_dev)) {
		return -1;
	}

	/* Register callback early so we catch IPM_ID_BUFADDR from procpu
	 * before it arrives (procpu sends it ~500ms after boot). */
	ipm_register_callback(ipm_dev, ipm_rx_cb, NULL);

	/* Wait for procpu USB + LittleFS init before sending first log */
	k_sleep(K_MSEC(1500));

	ipm_log("[C1] appcpu starting");

	/* Wait for procpu to send the PSRAM audio buffer address (ID=3).
	 * Timeout after 5 s — if it never arrives, fall back to the
	 * compile-time default baked into pdm.h (AUDIO_PSRAM_BASE). */
	for (int i = 0; i < 500 && audio_buf_addr == 0; i++) {
		k_sleep(K_MSEC(10));
	}

	if (audio_buf_addr != 0) {
		pdm_set_audio_buf(audio_buf_addr);
		ipm_log("[C1] audio buf addr: 0x%08X", audio_buf_addr);
	} else {
		ipm_log("[C1] WARN: buf addr not received, using default 0x%08X",
			AUDIO_PSRAM_BASE);
	}

	if (pdm_init(ipm_dev) < 0) {
		ipm_log("[C1] PDM init failed — halting");
		return -1;
	}

	if (play_init(ipm_dev) < 0) {
		ipm_log("[C1] I2S1 play init failed — speaker disabled");
		/* Non-fatal: continue without playback */
	} else {
		ipm_log("[C1] I2S1 playback ready (MAX98357A)");
	}

	ipm_log("[C1] ready — waiting for commands");

	while (1) {
		if (recording) {
			(void)pdm_record(&stop_pending);

			recording    = false;
			stop_pending = false;

			/* Speaker diagnostic mode: generated tone isolates TX/amp path
			 * from recorded mic data/PSRAM content. */
#if APPCPU_LOOPBACK_USE_TEST_TONE
			int perr = play_test_tone(1000U, 880U);
#else
			/* Speaker loopback test — play back the recording immediately.
			 * Remove once Milestone 5 (full round-trip) is validated. */
			int perr = play_audio_shared(audio_buf_addr, play_buf_addr);
#endif
			if (perr < 0) {
				ipm_log("[C1] loopback play failed: %d", perr);
			}

			/* Signal procpu that audio is ready. */
			uint8_t done = 1U;
			ipm_send(ipm_dev, 1, IPM_ID_DONE, &done, sizeof(done));
		} else if (play_pending) {
			play_pending = false;

			int err = play_from_shared(play_buf_addr);
			if (err < 0) {
				ipm_log("[C1] play_from_shared failed: %d", err);
			}
		} else {
			k_sleep(K_MSEC(10));
		}
	}

	return 0;
}
```

## src/pdm.c
```c
#include "pdm.h"

#include <zephyr/kernel.h>
#include <zephyr/cache.h>
#include <zephyr/drivers/i2s.h>
#include <zephyr/drivers/ipm.h>
#include <zephyr/device.h>
#include <string.h>
#include <stdio.h>
#include <stdarg.h>

/* ESP-IDF HAL/LL headers for PDM RX mode.
 * Zephyr's ESP32 I2S driver only supports standard I2S framing; it has no
 * PDM mode.  After i2s_configure() we patch the hardware registers directly
 * to enable the on-chip PDM→PCM decimation filter.
 */
#include <soc/i2s_struct.h>
#include <hal/i2s_ll.h>
#include <hal/i2s_types.h>

#define IPM_ID_LOG  0U

#define BLOCK_SAMPLES  (AUDIO_SAMPLE_RATE * BLOCK_MS / 1000)                  /* 320 frames */
#define BLOCK_BYTES    (BLOCK_SAMPLES * (SAMPLE_WIDTH / 8) * CHANNELS)  /* 1280 B     */
#define DMA_BLOCKS     4

K_MEM_SLAB_DEFINE_STATIC(rx_slab, BLOCK_BYTES, DMA_BLOCKS, 4);

static uint8_t *audio_buf = (uint8_t *)AUDIO_PSRAM_BASE;

void pdm_set_audio_buf(uint32_t addr)
{
	audio_buf = (uint8_t *)(uintptr_t)addr;
}

static const struct device *i2s_dev;
static const struct device *ipm_dev;

/* PDM slot mask for ESP32-S3 PDM RX: BIT0=right, BIT1=left. */
#ifndef PDM_ACTIVE_MASK
/* Keep parity with testapp_mic: enable both slots at RX and pick slot later. */
#define PDM_ACTIVE_MASK 0x03
#endif

static void pdm_log(const char *fmt, ...)
{
	char buf[128];
	va_list args;

	va_start(args, fmt);
	vsnprintf(buf, sizeof(buf), fmt, args);
	va_end(args);

	ipm_send(ipm_dev, 1, IPM_ID_LOG, buf, strlen(buf) + 1);
}

static void log_block_stats(const int16_t *samples, size_t count, uint32_t block_idx)
{
	int64_t l_sum = 0, l_sum_sq = 0;
	int64_t r_sum = 0, r_sum_sq = 0;
	uint32_t n = 0;
	int16_t l_min = 32767, l_max = -32768;
	int16_t r_min = 32767, r_max = -32768;
	int16_t first_non_trivial = 0;
	bool have_first = false;

	for (size_t i = 0; i + 1 < count; i += 2) {
		int32_t l = samples[i];
		int32_t r = samples[i + 1];

		l_sum += l;
		l_sum_sq += (int64_t)l * (int64_t)l;
		r_sum += r;
		r_sum_sq += (int64_t)r * (int64_t)r;
		n++;

		if (l < l_min) {
			l_min = (int16_t)l;
		}
		if (l > l_max) {
			l_max = (int16_t)l;
		}
		if (r < r_min) {
			r_min = (int16_t)r;
		}
		if (r > r_max) {
			r_max = (int16_t)r;
		}

		if (!have_first && l != 0 && l != -1 && l != 1) {
			first_non_trivial = (int16_t)l;
			have_first = true;
		}
	}

	if (n == 0U) {
		return;
	}

	int32_t l_mean = (int32_t)(l_sum / (int64_t)n);
	int32_t r_mean = (int32_t)(r_sum / (int64_t)n);
	uint32_t l_rms2 = (uint32_t)(l_sum_sq / (int64_t)n);
	uint32_t r_rms2 = (uint32_t)(r_sum_sq / (int64_t)n);
	int32_t l_p2p = (int32_t)l_max - (int32_t)l_min;
	int32_t r_p2p = (int32_t)r_max - (int32_t)r_min;
	int16_t s16 = have_first ? first_non_trivial : 0;
	uint16_t u16 = (uint16_t)s16;

	pdm_log("[C1] blk=%u n=%u L(mean=%d rms2=%u min=%d max=%d p2p=%d) R(mean=%d rms2=%u min=%d max=%d p2p=%d) sample_s16=%d sample_u16=%u sample_hex=0x%04x",
		block_idx, n,
		l_mean, l_rms2, l_min, l_max, l_p2p,
		r_mean, r_rms2, r_min, r_max, r_p2p,
		s16, u16, u16);
}

/* Keep this register patch sequence in parity with testapp_mic apply_pdm_patch(). */
static void apply_pdm_patch(void)
{
	/* Re-apply RX config after i2s_trigger(START), which resets RX mode. */
	I2S0.rx_conf.rx_start = 0;

	i2s_ll_rx_reset(&I2S0);
	i2s_ll_rx_set_slave_mod(&I2S0, false);
	i2s_ll_rx_set_sample_bit(&I2S0, 16, 16);
	i2s_ll_rx_set_half_sample_bit(&I2S0, 16);
	i2s_ll_rx_enable_mono_mode(&I2S0, false);
	i2s_ll_rx_set_active_chan_mask(&I2S0, PDM_ACTIVE_MASK);
	i2s_ll_rx_enable_pdm(&I2S0);

	/* Be explicit about PDM mode bits and PDM2PCM settings. */
	I2S0.rx_conf.rx_tdm_en = 0;
	I2S0.rx_conf.rx_pdm_en = 1;
	I2S0.rx_conf.rx_pdm2pcm_en = 1;
	i2s_ll_rx_set_pdm_dsr(&I2S0, I2S_PDM_DSR_8S); /* 64x downsample */

	/* Keep sample format deterministic. */
	i2s_ll_rx_enable_big_endian(&I2S0, false);
	i2s_ll_rx_enable_left_align(&I2S0, false);
	I2S0.rx_conf.rx_bit_order = 0;
	I2S0.rx_conf.rx_pcm_conf = 0;
	I2S0.rx_conf.rx_pcm_bypass = 1;

	i2s_ll_rx_start(&I2S0);
}

int pdm_init(const struct device *ipm)
{
	ipm_dev = ipm;
	i2s_dev = DEVICE_DT_GET(DT_NODELABEL(i2s0));

	if (!device_is_ready(i2s_dev)) {
		pdm_log("[C1] i2s0 not ready");
		return -ENODEV;
	}

	/*
	 * Zephyr's ESP32 I2S driver does not support PDM mode — it only
	 * handles standard I2S framing.  We use it here solely for DMA setup
	 * and clock generation, then patch the hardware into PDM RX mode below.
	 *
	 * Clock: the driver computes BCK = frame_clk_freq × channels × word_size.
	 * In PDM mode (rx_pdm_en=1) the ESP32-S3 hardware outputs the PDM bit
	 * clock on the WS signal (I2S0I_WS_OUT_IDX=27, GPIO42 via overlay) and
	 * reads incoming data against that same WS reference.  BCK (signal 26)
	 * is unused; rx_tdm_ws_width is bypassed and WS carries the PDM bit
	 * clock at the BCK-equivalent frequency (~1.053 MHz).
	 * Measured register values (rx_conf1, rx_clkm_conf):
	 *   MCLK = 160MHz / 19 = 8.421 MHz
	 *   PDM clock (WS in PDM mode) = 8.421MHz / 8 = 1.053 MHz  ✓
	 * The MSM261S4030H0R requires 1–3.25 MHz: 1.053 MHz is within spec.
	 * The hardware PDM2PCM decimator (64×) produces PCM at ~16.4 kHz.
	 * Setting frame_clk_freq = AUDIO_SAMPLE_RATE * 2 gives:
	 *   target BCK = 32000 × 2 × 16 = 1,024,000 Hz (actual: 1,053,000 due to
	 *   integer clock division — acceptable, within mic spec).
	 *
	 * channels=2: required by the DMA controller; mono PDM mic data
	 * arrives on the left channel, right channel is zeros.
	 */
	struct i2s_config cfg = {
		.word_size      = SAMPLE_WIDTH,
		.channels       = CHANNELS,
		.format         = I2S_FMT_DATA_FORMAT_I2S,
		.options        = I2S_OPT_FRAME_CLK_MASTER | I2S_OPT_BIT_CLK_MASTER,
		.frame_clk_freq = AUDIO_SAMPLE_RATE * 2, /* sets BCK = 1.024 MHz for PDM */
		.mem_slab       = &rx_slab,
		.block_size     = BLOCK_BYTES,
		.timeout        = BLOCK_MS * 2, /* 40 ms: 2× block period, fast stop response */
	};

	int ret = i2s_configure(i2s_dev, I2S_DIR_RX, &cfg);

	if (ret < 0) {
		pdm_log("[C1] i2s_configure failed: %d", ret);
		return ret;
	}

	pdm_log("[C1] i2s configured; PDM register patch will be applied on START");
	return 0;
}

uint32_t pdm_record(volatile bool *stop_flag)
{
	uint32_t audio_pos = 0;
	uint32_t block_idx = 0;
	uint32_t eio_recoveries = 0;
	bool recovered_this_capture = false;

	/* Write the shared header into the buffer before recording starts.
	 * byte_count is filled in after the loop once we know the final size. */
	struct audio_shared *shdr = (struct audio_shared *)audio_buf;

	shdr->magic       = AUDIO_SHARED_MAGIC;
	shdr->byte_count  = 0;
	shdr->sample_rate = AUDIO_SAMPLE_RATE;
	shdr->channels    = AUDIO_CHANNELS;
	shdr->bits        = AUDIO_BITS;

	/* Ensure RX queue/state is clean between button-driven captures. */
	(void)i2s_trigger(i2s_dev, I2S_DIR_RX, I2S_TRIGGER_DROP);

	int ret = i2s_trigger(i2s_dev, I2S_DIR_RX, I2S_TRIGGER_START);

	if (ret < 0) {
		pdm_log("[C1] i2s start failed: %d", ret);
		return 0;
	}

	/*
	 * i2s_trigger(START) calls i2s_hal_rx_reset() internally which, on
	 * ESP32-S3, resets the I2S RX operating mode (clears rx_pdm_en etc.)
	 * back to hardware defaults.  The Zephyr driver then commits standard
	 * I2S mode via rx_update.
	 *
	 * Replicate the full ESP-IDF i2s_hal_pdm_set_rx_slot() + enable +
	 * start sequence to switch the hardware to PDM RX mode:
	 *   1. Stop I2S RX (GDMA stays armed; just pauses FIFO drain).
	 *   2. Reset RX module to a clean slate.
	 *   3. Re-apply all RX slot config for PDM (ESP32-S3 HW v2 path).
	 *   4. Enable PDM→PCM conversion.
	 *   5. i2s_ll_rx_start(): rx_update=1 (clocks config into RX domain),
	 *      wait for hw ack, rx_start=1.
	 */
	apply_pdm_patch();

	/*
	 * Dump registers AFTER rx_start so we see the in-effect RX domain config.
	 * If rx_pdm2pcm_en is 0 here, audio will be white noise (raw 1-bit PDM).
	 */
	pdm_log("[C1] rx_conf=0x%08X (tdm=%u pdm=%u pdm2pcm=%u dsr128=%u) rx_conf1=0x%08X clkm=0x%08X",
		I2S0.rx_conf.val,
		I2S0.rx_conf.rx_tdm_en,
		I2S0.rx_conf.rx_pdm_en,
		I2S0.rx_conf.rx_pdm2pcm_en,
		I2S0.rx_conf.rx_pdm_sinc_dsr_16_en,
		I2S0.rx_conf1.val,
		I2S0.rx_clkm_conf.val);
	pdm_log("[C1] PDM_ACTIVE_MASK=0x%02X (right=%u left=%u)",
		PDM_ACTIVE_MASK,
		(PDM_ACTIVE_MASK & 0x01) ? 1 : 0,
		(PDM_ACTIVE_MASK & 0x02) ? 1 : 0);

	pdm_log("[C1] recording started");

	while (!(*stop_flag)) {
		void  *block     = NULL;
		size_t block_size = 0;

		ret = i2s_read(i2s_dev, &block, &block_size);

		if (ret == 0 && block != NULL) {
			const int16_t *samples = (const int16_t *)block;
			uint32_t sample_count = block_size / sizeof(int16_t);
			uint32_t stereo_pairs = sample_count / 2U;
			uint32_t mono_space_pairs = (AUDIO_PCM_MAX - audio_pos) /
						    sizeof(int16_t);
			uint32_t frames = stereo_pairs;

			if (frames > mono_space_pairs) {
				frames = mono_space_pairs;
			}

			// if ((block_idx % 10U) == 0U) {
			// 	log_block_stats((const int16_t *)block, block_size / sizeof(int16_t),
			// 			block_idx);
			// }

			/* Per-block mono conversion: keep LEFT slot only. */
			int16_t *mono_dst = (int16_t *)(shdr->pcm + audio_pos);
			for (uint32_t i = 0; i < frames; i++) {
				mono_dst[i] = samples[2U * i];
			}

			audio_pos += frames * sizeof(int16_t);
			k_mem_slab_free(&rx_slab, block);
			block_idx++;

			if (frames < stereo_pairs || audio_pos >= AUDIO_PCM_MAX) {
				pdm_log("[C1] buffer full — auto-stopping (pcm=%u)",
					audio_pos);
				break;
			}
		} else if (ret != -EAGAIN) {
			if (ret == -EIO && !recovered_this_capture && !(*stop_flag)) {
				eio_recoveries++;
				pdm_log("[C1] i2s_read EIO; attempting RX recovery (%u)",
					eio_recoveries);
				(void)i2s_trigger(i2s_dev, I2S_DIR_RX, I2S_TRIGGER_DROP);
				ret = i2s_trigger(i2s_dev, I2S_DIR_RX, I2S_TRIGGER_START);
				if (ret < 0) {
					pdm_log("[C1] RX recovery START failed: %d", ret);
					break;
				}
				apply_pdm_patch();
				recovered_this_capture = true;
				continue;
			}
			pdm_log("[C1] i2s_read error: %d", ret);
		}
	}

	i2s_trigger(i2s_dev, I2S_DIR_RX, I2S_TRIGGER_STOP);

	/* Drain any in-flight DMA blocks */
	void  *drain = NULL;
	size_t sz    = 0;

	while (i2s_read(i2s_dev, &drain, &sz) == 0 && drain != NULL) {
		k_mem_slab_free(&rx_slab, drain);
		drain = NULL;
	}

	/* Fill in byte_count now that we know the final PCM size. */
	shdr->byte_count = audio_pos;

	/* Flush header + PCM. */
	sys_cache_data_flush_range((void *)audio_buf,
				   sizeof(struct audio_shared) + audio_pos);

	pdm_log("[C1] recording done: pcm=%u bytes (eio_recoveries=%u)",
		audio_pos, eio_recoveries);
	return audio_pos;
}
```

## src/pdm.h
```c
#pragma once

#include <zephyr/drivers/ipm.h>
#include "audio_shared.h"

/*
 * PDM microphone capture via I2S0.
 *   GPIO42 = PDM_CLK (I2S WS output, PDM bit clock ~1 MHz)
 *   GPIO41 = PDM_DATA (I2S SD input, bias-pull-down)
 * 16kHz, 16-bit, stereo DMA (mic data in left slot, right slot = zeros).
 * Per-block mono extraction: left slot only written to PSRAM.
 *
 * Shared PSRAM layout (struct audio_shared header + raw mono PCM):
 *   See embedded/common/audio_shared.h
 *
 * AUDIO_PSRAM_BASE: compile-time fallback only — the real address is sent
 * by procpu at boot via IPM_ID_BUFADDR and applied via pdm_set_audio_buf().
 * Verify after a procpu rebuild:
 *   grep audio_psram_buf build/procpu/zephyr/zephyr_final.map
 */
#define AUDIO_PSRAM_BASE  0x3C0B0000UL

#define SAMPLE_WIDTH   16
#define CHANNELS       2    /* DMA requires stereo; mic data is in left slot */
#define BLOCK_MS       20

/*
 * Set the PSRAM audio buffer address before calling pdm_init().
 * The address is received from procpu via IPM at startup so both cores
 * always agree on the linker-allocated location.
 */
void pdm_set_audio_buf(uint32_t addr);

/* Initialise the I2S driver. ipm_dev is used for log forwarding to procpu. */
int pdm_init(const struct device *ipm_dev);

/*
 * Capture PCM into PSRAM until stop_flag becomes true or the buffer is full.
 * Returns the number of bytes written (PCM only, excluding header).
 */
uint32_t pdm_record(volatile bool *stop_flag);
```

## src/play.c
```c
/*
 * play.c — I2S1 WAV playback through MAX98357A (Milestone 4, appcpu)
 *
 * appcpu owns all I2S/DMA: I2S0 for PDM mic capture, I2S1 for speaker output.
 * This avoids cross-core GDMA hardware conflicts that occur when procpu
 * initialises its own I2S driver — the ESP32-S3 GDMA global init on one core
 * corrupts the channel state the other core relies on.
 *
 * Procpu receives TTS WAV frames via WebSocket, writes them into the shared
 * PSRAM struct play_shared, flushes the cache, and sends IPM_ID_PLAY.
 * appcpu calls play_from_shared() which owns all cache invalidation,
 * magic validation, and I2S DMA feeding.
 *
 * Audio format: Piper TTS emits 22050 Hz 16-bit mono WAV.  The sample rate is
 * parsed from the WAV header each call so the server can change voices without
 * a firmware update.  Mono PCM is duplicated to stereo (L=R) before writing
 * to the I2S1 DMA.
 *
 * Pins (set in appcpu.overlay):
 *   BCLK  GPIO2 → I2S1_O_BCK
 *   LRCLK GPIO3 → I2S1_O_WS
 *   DOUT  GPIO4 → I2S1_O_SD  (into MAX98357A DIN)
 */

#include "play.h"
#include "audio_shared.h"

#include <zephyr/kernel.h>
#include <zephyr/drivers/i2s.h>
#include <zephyr/drivers/ipm.h>
#include <zephyr/drivers/gpio.h>
#include <zephyr/cache.h>
#include <zephyr/logging/log.h>
#include <string.h>
#include <stdio.h>
#include <stdarg.h>
#include <limits.h>

LOG_MODULE_DECLARE(appcpu, LOG_LEVEL_DBG);

#define IPM_ID_LOG  0U

static const struct device *play_ipm;

static void play_log(const char *fmt, ...)
{
	char buf[128];
	va_list args;

	va_start(args, fmt);
	vsnprintf(buf, sizeof(buf), fmt, args);
	va_end(args);

	if (play_ipm) {
		ipm_send(play_ipm, 1, IPM_ID_LOG, buf, strlen(buf) + 1);
	}
}

#define I2S_NODE  DT_NODELABEL(i2s1)

/*
 * DMA slab in regular BSS (appcpu linker has no .ext_ram.bss).
 * BLOCK_SIZE / 4 stereo frames per block.
 * At 16kHz: 4096/4 / 16000 = 64 ms per block.
 *
 * BLOCK_COUNT=4: pre-queuing all 4 blocks before I2S_TRIGGER_START leaves 3
 * in the driver's internal queue after the first block is dequeued.  This
 * gives the main thread ~192 ms of runway to refill the queue, preventing the
 * DMA ISR from seeing an empty queue between blocks and stopping with
 * state=ERROR (which makes subsequent i2s_buf_write calls fail with -EIO).
 * Must be ≤ CONFIG_I2S_ESP32_TX_BLOCK_COUNT (default 5).
 */
#define BLOCK_SIZE   4096
#define BLOCK_COUNT  4
#define AMP_UNMUTE_DELAY_MS 20U

K_MEM_SLAB_DEFINE_STATIC(play_slab, BLOCK_SIZE, BLOCK_COUNT, 4);

static const struct device *i2s_dev;
static const struct gpio_dt_spec amp_en = GPIO_DT_SPEC_GET(DT_ALIAS(amp_en), gpios);
/* Large enough for ~1.5 s @ 16kHz mono. */
#define TONE_MAX_SAMPLES 24000U
static int16_t tone_buf[TONE_MAX_SAMPLES];

struct tts_filter_state {
	int32_t dc_x_prev;
	int32_t dc_y_prev;
	int32_t lp_y_prev;
};

struct tts_filter_config {
	/* DC blocker coefficient in Q15 (higher = lower cutoff). */
	int32_t dc_block_a_q15;
	/* One-pole LP smoothing divisor: y += (x - y) / lp_div. */
	int32_t lp_div;
	/* Noise gate threshold (absolute sample value). */
	int32_t gate_abs_threshold;
};

static const struct tts_filter_config tts_cfg = {
	.dc_block_a_q15 = 32604, /* ~0.995 */
	.lp_div = 4,             /* gentle smoothing */
	.gate_abs_threshold = 80,
};

static int16_t apply_edge_fade(int16_t s, size_t idx, size_t total, size_t fade_samples)
{
	if (total == 0 || fade_samples == 0) {
		return s;
	}

	int32_t gain_q15 = 32767;
	if (idx < fade_samples) {
		gain_q15 = (int32_t)((idx * 32767U) / fade_samples);
	}

	size_t rem = total - idx; /* rem >= 1 while idx < total */
	if (rem <= fade_samples) {
		int32_t tail_q15 = (int32_t)(((rem - 1U) * 32767U) / fade_samples);
		if (tail_q15 < gain_q15) {
			gain_q15 = tail_q15;
		}
	}

	return (int16_t)(((int32_t)s * gain_q15) / 32767);
}

/* TTS de-hiss chain:
 *  1) DC blocker (1st-order high-pass)
 *  2) Gentle low-pass to tame high-frequency hiss
 *  3) Small noise gate near zero
 */
static int16_t filter_tts_sample(int16_t s, struct tts_filter_state *st)
{
	const int32_t lp_div = (tts_cfg.lp_div > 0) ? tts_cfg.lp_div : 1;

	/* y[n] = x[n] - x[n-1] + a*y[n-1]. */
	int32_t x = s;
	int32_t y_hp = x - st->dc_x_prev +
		       ((st->dc_y_prev * tts_cfg.dc_block_a_q15) / 32767);
	st->dc_x_prev = x;
	st->dc_y_prev = y_hp;

	/* One-pole LPF: y += (x - y) / lp_div. */
	int32_t y_lp = st->lp_y_prev + ((y_hp - st->lp_y_prev) / lp_div);
	st->lp_y_prev = y_lp;

	/* Small gate to suppress idle quantization hiss. */
	if (y_lp > -tts_cfg.gate_abs_threshold &&
	    y_lp < tts_cfg.gate_abs_threshold) {
		y_lp = 0;
	}

	if (y_lp > INT16_MAX) {
		y_lp = INT16_MAX;
	} else if (y_lp < INT16_MIN) {
		y_lp = INT16_MIN;
	}

	return (int16_t)y_lp;
}

int play_init(const struct device *ipm)
{
	play_ipm = ipm;
	i2s_dev = DEVICE_DT_GET(I2S_NODE);
	if (!device_is_ready(i2s_dev)) {
		return -ENODEV;
	}

	if (!gpio_is_ready_dt(&amp_en)) {
		play_log("[C1] amp_en GPIO not ready");
		return -ENODEV;
	}

	int ret = gpio_pin_configure_dt(&amp_en, GPIO_OUTPUT_INACTIVE);
	if (ret < 0) {
		play_log("[C1] amp_en configure failed: %d", ret);
		return ret;
	}

	return 0;
}

static uint32_t wav_sample_rate(const uint8_t *wav, size_t len)
{
	if (len < 28 ||
	    memcmp(wav,     "RIFF", 4) != 0 ||
	    memcmp(wav + 8, "WAVE", 4) != 0) {
		return 0;
	}
	uint32_t sr;
	memcpy(&sr, wav + 24, 4);
	return sr;
}

static size_t wav_data_offset(const uint8_t *wav, size_t len)
{
	if (len < 44) {
		return 0;
	}
	for (size_t i = 12; i + 8 <= len; ) {
		uint32_t chunk_size;
		memcpy(&chunk_size, wav + i + 4, 4);
		if (memcmp(wav + i, "data", 4) == 0) {
			return i + 8;
		}
		i += 8 + chunk_size;
	}
	return 0;
}

/*
 * Core DMA feeding loop.  Configures I2S1, pre-queues BLOCK_COUNT blocks
 * before triggering START (prevents TX underrun → DMA stall → slab hang),
 * then feeds the rest.  mono[] is 16-bit mono PCM; duplicated to stereo L=R.
 */
static int play_pcm(uint32_t sample_rate, const int16_t *mono, size_t n_mono,
		    bool tts_cleanup)
{
	/* Keep amplifier muted during I2S TX startup transient. */
	(void)gpio_pin_set_dt(&amp_en, 0);

	/* Reset TX state between button-driven plays. */
	(void)i2s_trigger(i2s_dev, I2S_DIR_TX, I2S_TRIGGER_DROP);

	struct i2s_config cfg = {
		/* Match ESP-IDF/Arduino TX framing used with MAX98357A:
		 * 32-bit I2S slots, mono data on left slot. */
		.word_size      = 32,
		.channels       = 2,
		.format         = I2S_FMT_DATA_FORMAT_I2S,
		.options        = I2S_OPT_BIT_CLK_MASTER |
				  I2S_OPT_FRAME_CLK_MASTER,
		.frame_clk_freq = sample_rate,
		.mem_slab       = &play_slab,
		.block_size     = BLOCK_SIZE,
		.timeout        = 2000,
	};

	int ret = i2s_configure(i2s_dev, I2S_DIR_TX, &cfg);
	if (ret < 0) {
		play_log("[C1] play_pcm: i2s_configure failed: %d", ret);
		return ret;
	}

	/* i2s_buf_write() copies into driver-owned slab blocks internally. */
	int32_t tx_block[BLOCK_SIZE / 4];
	const size_t frames_per_block = BLOCK_SIZE / 8; /* 32-bit stereo frames */
	const size_t fade_samples = MAX((size_t)(sample_rate / 50U), (size_t)1U); /* 20 ms */
	struct tts_filter_state filt = {0};

	size_t src = 0;
	int pre_queued = 0;

	// Fill up a few DMA blocks to prevent TX underrun at startup
	for (int pre = 0; pre < BLOCK_COUNT && src < n_mono; pre++) {
		size_t n = MIN(frames_per_block, n_mono - src);

		for (size_t i = 0; i < n; i++) {
			int16_t s = apply_edge_fade(mono[src + i], src + i, n_mono, fade_samples);
			if (tts_cleanup) {
				s = filter_tts_sample(s, &filt);
			}
			/* Mirror mono to both slots for MAX98357A robustness. */
			tx_block[i * 2] = ((int32_t)s) << 16;
			tx_block[i * 2 + 1] = ((int32_t)s) << 16;
		}
		if (n < frames_per_block) {
			memset(&tx_block[n * 2], 0, (frames_per_block - n) * 8);
		}
		src += n;

		if (i2s_buf_write(i2s_dev, tx_block, BLOCK_SIZE) < 0) {
			play_log("[C1] play_pcm: pre-queue buf_write failed at %d", pre);
			break;
		}
		pre_queued++;
	}

	play_log("[C1] play_pcm: pre-queued=%d src=%u n_mono=%u sr=%u",
		 pre_queued, (unsigned)src, (unsigned)n_mono, (unsigned)sample_rate);

	ret = i2s_trigger(i2s_dev, I2S_DIR_TX, I2S_TRIGGER_START);
	if (ret < 0) {
		play_log("[C1] play_pcm: START failed: %d", ret);
		i2s_trigger(i2s_dev, I2S_DIR_TX, I2S_TRIGGER_DROP);
		return ret;
	}

	k_sleep(K_MSEC(AMP_UNMUTE_DELAY_MS));
	(void)gpio_pin_set_dt(&amp_en, 1);

	int feed_count = 0;
	int write_errors = 0;

	// Now play the actual audio
	while (src < n_mono) {
		size_t n = MIN(frames_per_block, n_mono - src);

		for (size_t i = 0; i < n; i++) {
			int16_t s = apply_edge_fade(mono[src + i], src + i, n_mono, fade_samples);
			if (tts_cleanup) {
				s = filter_tts_sample(s, &filt);
			}
			tx_block[i * 2] = ((int32_t)s) << 16;
			tx_block[i * 2 + 1] = ((int32_t)s) << 16;
		}
		if (n < frames_per_block) {
			memset(&tx_block[n * 2], 0, (frames_per_block - n) * 8);
		}
		src += n;

		if (i2s_buf_write(i2s_dev, tx_block, BLOCK_SIZE) < 0) {
			write_errors++;
			play_log("[C1] play_pcm: buf_write error #%d at feed=%d src=%u",
				 write_errors, feed_count, (unsigned)src);
			if (write_errors >= 3) {
				break;
			}
			continue;
		}
		feed_count++;
	}

	play_log("[C1] play_pcm: done feeding feed=%d write_err=%d src=%u free=%u",
		 feed_count, write_errors,
		 (unsigned)src, (unsigned)k_mem_slab_num_free_get(&play_slab));

	i2s_trigger(i2s_dev, I2S_DIR_TX, I2S_TRIGGER_DRAIN);

	for (int t = 0; t < 60; t++) {
		if (k_mem_slab_num_free_get(&play_slab) == BLOCK_COUNT) {
			break;
		}
		k_sleep(K_MSEC(10));
	}

	uint32_t free_after = k_mem_slab_num_free_get(&play_slab);

	play_log("[C1] play_pcm: drain done free=%u/%d", free_after, BLOCK_COUNT);
	(void)gpio_pin_set_dt(&amp_en, 0);

	/* If drain timed out (driver errored mid-playback), force-clean state. */
	if (free_after < BLOCK_COUNT) {
		i2s_trigger(i2s_dev, I2S_DIR_TX, I2S_TRIGGER_DROP);
		/* Slab slots held by the driver are permanently lost at this point.
		 * A future call to play_pcm will fail at pre-queue if too many are
		 * leaked.  Full recovery requires a driver restart. */
		play_log("[C1] play_pcm: drain timeout — %u slots leaked",
			 BLOCK_COUNT - free_after);
	}

	return 0;
}

static int play_wav(const uint8_t *wav, uint32_t len)
{
	uint32_t sample_rate = wav_sample_rate(wav, len);
	if (sample_rate == 0) {
		return -EINVAL;
	}

	size_t data_off = wav_data_offset(wav, len);
	if (data_off == 0 || data_off >= len) {
		return -EINVAL;
	}

	return play_pcm(sample_rate,
			(const int16_t *)(wav + data_off),
			(len - data_off) / 2,
			true);
}

/*
 * Loopback test: read raw PCM directly from struct audio_shared and feed it
 * to the speaker — no WAV header construction needed.
 */
int play_audio_shared(uint32_t rec_addr, uint32_t play_buf_addr)
{
	ARG_UNUSED(play_buf_addr);

	if (rec_addr == 0) {
		return -EINVAL;
	}

	struct audio_shared *as = (struct audio_shared *)(uintptr_t)rec_addr;

	sys_cache_data_invd_range(as, sizeof(struct audio_shared));

	uint32_t byte_count  = as->byte_count;
	uint32_t sample_rate = as->sample_rate;

	if (byte_count == 0 || sample_rate == 0) {
		return -EINVAL;
	}

	sys_cache_data_invd_range(as->pcm, byte_count);

	return play_pcm(sample_rate, (const int16_t *)as->pcm, byte_count / 2, false);
}

int play_from_shared(uint32_t psram_addr)
{
	if (!i2s_dev) {
		return -ENODEV;
	}

	if (psram_addr == 0) {
		return -EINVAL;
	}

	struct play_shared *ps = (struct play_shared *)(uintptr_t)psram_addr;

	/* Invalidate cache: header first to read len, then the WAV payload. */
	sys_cache_data_invd_range(ps, sizeof(struct play_shared));
	sys_cache_data_invd_range(ps->wav, ps->len);

	if (ps->magic != PLAY_SHARED_MAGIC) {
		return -EBADMSG;
	}

	return play_wav(ps->wav, ps->len);
}

int play_test_tone(uint32_t duration_ms, uint32_t freq_hz)
{
	const uint32_t sample_rate = 16000U;

	if (duration_ms == 0U) {
		duration_ms = 1000U;
	}
	if (freq_hz == 0U) {
		freq_hz = 880U;
	}

	size_t n = ((uint64_t)sample_rate * duration_ms) / 1000U;
	if (n > TONE_MAX_SAMPLES) {
		n = TONE_MAX_SAMPLES;
	}

	/* 32-bit phase accumulator triangle wave: stable and no libm needed. */
	uint32_t phase = 0;
	uint32_t step = (uint32_t)(((uint64_t)freq_hz << 32) / sample_rate);
	const int32_t amp = 9000; /* conservative level */

	for (size_t i = 0; i < n; i++) {
		phase += step;
		uint16_t ramp = (uint16_t)(phase >> 16);
		int32_t tri = (ramp < 32768U) ? ramp : (65535U - ramp); /* 0..32767 */
		int32_t centered = (tri * 2) - 32767; /* approx -32767..32767 */
		tone_buf[i] = (int16_t)((centered * amp) / 32767);
	}

	return play_pcm(sample_rate, tone_buf, n, false);
}
```

## src/play.h
```c
#pragma once

#include <stdint.h>
#include <zephyr/drivers/ipm.h>

/*
 * Initialize I2S1 TX for speaker playback (MAX98357A).
 * ipm is used for diagnostic logging during development.
 * Must be called once before play_from_shared().
 */
int play_init(const struct device *ipm);

/*
 * Play a WAV from a struct play_shared in PSRAM at the given address.
 * Invalidates the cache, validates the magic, and plays wav[0..len].
 * Blocks until all audio has been clocked out (DRAIN).
 */
int play_from_shared(uint32_t psram_addr);

/*
 * Loopback test: play back a recording from struct audio_shared in PSRAM.
 * Reads sample_rate + raw PCM directly — no WAV header needed.
 * play_buf_addr is unused (kept for API symmetry with main.c; may be removed).
 * Blocks until all audio has been clocked out.
 */
int play_audio_shared(uint32_t rec_addr, uint32_t play_buf_addr);

/*
 * Speaker path diagnostic: play a generated tone on I2S1.
 * Useful to isolate amplifier/I2S TX issues from microphone capture data.
 */
int play_test_tone(uint32_t duration_ms, uint32_t freq_hz);
```
