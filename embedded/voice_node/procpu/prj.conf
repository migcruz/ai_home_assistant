## CMakeLists.txt
```
cmake_minimum_required(VERSION 3.20.0)
find_package(Zephyr REQUIRED HINTS $ENV{ZEPHYR_BASE})
project(procpu)

target_sources(
    app
    PRIVATE
    src/main.c
    src/storage.c
    src/button.c
    src/audio.c
    src/wifi.c
    src/websocket.c
    # ../common/sd_wav.c  # re-enable with SD/FAT Kconfig for audio debug
    )
target_include_directories(app PRIVATE ${CMAKE_CURRENT_SOURCE_DIR}/../common)
```

## prj.conf
```kconfig
# voice_node — Seeed XIAO ESP32S3 Sense
# Milestone 2: WiFi + TLS + WebSocket connectivity
#
# Build:  west build --sysbuild -d build -b xiao_esp32s3/esp32s3/procpu/sense procpu
# Flash:  west flash --sysbuild -d build  (run inside the container)

# ── WiFi ──────────────────────────────────────────────────────────────────────
CONFIG_WIFI=y
CONFIG_NET_L2_WIFI_MGMT=y

# ── Networking ────────────────────────────────────────────────────────────────
CONFIG_NETWORKING=y
CONFIG_NET_IPV4=y
CONFIG_NET_TCP=y
CONFIG_NET_SOCKETS=y
CONFIG_DNS_RESOLVER=y
CONFIG_NET_DHCPV4=y

# net iface, ping, dns, sockets, routes, stats
CONFIG_NET_SHELL=y
# wifi scan/connect/disconnect/status
CONFIG_NET_L2_WIFI_SHELL=y

# ── TLS ───────────────────────────────────────────────────────────────────────
CONFIG_MBEDTLS=y
CONFIG_NET_SOCKETS_SOCKOPT_TLS=y
CONFIG_TLS_CREDENTIALS=y
# Default is 1 — we only open one TLS session at a time.
CONFIG_NET_SOCKETS_TLS_MAX_CONTEXTS=1
# Reduce per-connection TLS record buffer from 16KB to 4KB to save RAM.
# Voice service messages are small JSON + chunked WAV; 4KB records are fine.
CONFIG_MBEDTLS_SSL_MAX_CONTENT_LEN=4096
# mbedTLS heap — placed in PSRAM (.mbedtls_heap section) via
# CONFIG_MBEDTLS_HEAP_CUSTOM_SECTION.  The ESP32S3 default.ld already maps
# KEEP(*(.mbedtls_heap*)) into the .ext_ram.data PSRAM region, so this
# 60KB buffer costs zero DRAM.
CONFIG_MBEDTLS_ENABLE_HEAP=y
CONFIG_MBEDTLS_HEAP_SIZE=60000
CONFIG_MBEDTLS_HEAP_CUSTOM_SECTION=y
# Required to parse the PEM-format CA cert in server_cert.h.
# Without this, mbedTLS only supports DER (binary) format and
# mbedtls_x509_crt_parse() returns an error → setsockopt EINVAL.
CONFIG_MBEDTLS_PEM_CERTIFICATE_FORMAT=y

# ── WebSocket ─────────────────────────────────────────────────────────────────
CONFIG_WEBSOCKET_CLIENT=y
CONFIG_HTTP_CLIENT=y

# ── DNS server ────────────────────────────────────────────────────────────────
# Zephyr's DNS resolver does not automatically pick up the nameserver from DHCP.
# Statically configure the home router (gateway) as the DNS server.
# The router's dnsmasq knows about "vulcan" from its DHCP lease table.
CONFIG_DNS_SERVER_IP_ADDRESSES=y
CONFIG_DNS_SERVER1="10.0.0.1"

# ── PSRAM (external 8MB — required for TLS heap + audio buffers) ──────────────
CONFIG_ESP_SPIRAM=y
CONFIG_SPIRAM_MODE_OCT=y

# ── GPIO ──────────────────────────────────────────────────────────────────────
# CONFIG_GPIO=y
# CONFIG_GPIO_SHELL=y          # gpio get/set/toggle — useful for testing I2S pins

# ── Storage (LittleFS on storage_partition, 0x3b0000, 192KB) ─────────────
CONFIG_FLASH=y
CONFIG_FLASH_MAP=y
CONFIG_FILE_SYSTEM=y
CONFIG_FILE_SYSTEM_LITTLEFS=y

# ── SD/FAT — debug WAV dump (disabled: RX writes replaced by I2S playback,
#             TX write commented out; re-enable to debug audio capture) ───────
# CONFIG_SPI=y
# CONFIG_DISK_ACCESS=y
# CONFIG_FAT_FILESYSTEM_ELM=y
# CONFIG_FS_FATFS_CUSTOM_MOUNT_POINT_COUNT=1
# CONFIG_FS_FATFS_CUSTOM_MOUNT_POINTS="SD"
# CONFIG_FS_FATFS_NUM_FILES=1
# CONFIG_FS_FATFS_NUM_DIRS=1

# ── IPC (inter-processor communication — PRO CPU ↔ APP CPU) ──────────────────
CONFIG_IPM=y

# ── Shell ─────────────────────────────────────────────────────────────────────
# Interactive shell over the same UART as the console. Built-in commands:
# kernel, net, wifi, log — useful for runtime inspection without reflashing.
CONFIG_SHELL=y
CONFIG_SHELL_BACKEND_SERIAL=y
# Reduce shell UART TX ring buffer for DRAM headroom.
CONFIG_SHELL_BACKEND_SERIAL_TX_RING_BUFFER_SIZE=512

# ── Logging over USB Serial/JTAG (built into ESP32S3, no USB stack needed) ────
# The ESP32S3 routes UART0 over USB-C natively via the USB Serial/JTAG
# peripheral. CONFIG_LOG_BACKEND_UART sends output there automatically.
CONFIG_UART_CONSOLE=y
CONFIG_LOG=y
CONFIG_LOG_DEFAULT_LEVEL=3

# ── ESP32 internal timer task ─────────────────────────────────────────────────
# Default is 4096 in DRAM; WiFi and BLE callbacks are simple, 2048 is plenty.
# Saves exactly 2048 bytes from .dram0.bss.
CONFIG_ESP32_TIMER_TASK_STACK_SIZE=2048

# ── Logging ───────────────────────────────────────────────────────────────────
# Reduce internal log buffer for extra DRAM headroom.
CONFIG_LOG_BUFFER_SIZE=512
# Enable error-level logs from the TLS socket layer (net_sock_tls module).
# Default is 0 (NONE) which silences NET_ERR() calls inside sockets_tls.c.
CONFIG_NET_SOCKETS_LOG_LEVEL_ERR=y

# ── Memory ────────────────────────────────────────────────────────────────────
# Keep enough DRAM heap for WiFi/LwIP while freeing room for FAT/SD debug path.
CONFIG_HEAP_MEM_POOL_SIZE=45336

# ── Network packet pools ───────────────────────────────────────────────────────
# net_pkt struct is 68 bytes (confirmed from zephyr.map: 0x88 for 2 entries).
# RX=2 caused "Failed to allocate net buffer" during sustained audio sends:
# net_work is busy processing TCP TX segments; incoming TCP ACKs need an RX
# slot; with only 2 slots both stay occupied >100ms → alloc times out →
# ACKs are dropped → TCP send window stalls → ws_send_binary blocks forever.
# Increasing RX to 4 costs 2 × 68 = 136 bytes of DRAM.
CONFIG_NET_PKT_RX_COUNT=3
# Pin NET_BUF_RX_COUNT to prevent auto-scaling when NET_PKT_RX_COUNT increases.
CONFIG_NET_BUF_RX_COUNT=32
CONFIG_NET_PKT_TX_COUNT=2

# Connection handler table: DHCP (1) + DNS (1) + TCP WebSocket (1) = 3 minimum.
# Restore to the Zephyr default of 4 to leave headroom.
CONFIG_NET_MAX_CONN=4
# SD write and WebSocket send are sequential (not nested), so stack depth is
# max(FatFS path, TLS/WS path). TLS/WS already fitted at 4096 before SD was added.
CONFIG_MAIN_STACK_SIZE=4096
# Default is 2048; our net_mgmt callback only sets a semaphore + logs.
CONFIG_NET_MGMT_EVENT_STACK_SIZE=1024

# ── WiFi credentials (do not commit — use credentials.conf) ───────────────────
# CONFIG_WIFI_SSID="YourNetwork"
# CONFIG_WIFI_PSK="YourPassword"
```

## socs/esp32s3_procpu_sense.overlay
```dts
/* Enable IPM for PRO CPU ↔ APP CPU inter-processor communication */
&ipm0 {
	status = "okay";
};
```

## src/main.c
```c
/*
 * procpu — PRO CPU (Core 0)
 *
 * Drives the BOOT button (interrupt-driven) and waits for audio done from
 * appcpu. On done, reads PCM from shared PSRAM, builds a WAV file, strips
 * the silent right channel, and streams mono PCM to the voice service.
 *
 * IPM message IDs (shared with appcpu/src/main.c):
 *   id=0  appcpu → procpu   log string
 *   id=1  procpu → appcpu   command: uint8_t 1=start, 0=stop
 *   id=2  appcpu → procpu   done:    signal only (byte_count lives in struct audio_shared)
 *   id=3  procpu → appcpu   buf_addr: uint32_t address of audio_psram_buf
 */

#include <zephyr/kernel.h>
#include <zephyr/logging/log.h>
#include <zephyr/drivers/gpio.h>
#include <zephyr/drivers/ipm.h>
#include <zephyr/device.h>
#include <zephyr/cache.h>
#include <stdint.h>
#include <string.h>
#include "storage.h"
#include "button.h"
#include "audio.h"
#include "wifi.h"
#include "websocket.h"
#include "ipm_ids.h"
/* #include "sd_wav.h" — re-enable with SD/FAT Kconfig for audio debug */

LOG_MODULE_REGISTER(procpu, LOG_LEVEL_DBG);

static const struct gpio_dt_spec led = GPIO_DT_SPEC_GET(DT_ALIAS(led0), gpios);

// #define SD_DISK_NAME "SD"
// #define SD_MOUNT_POINT "/SD:"
// #define SD_WAV_PATH "/SD:/VOICEDBG.WAV"
// #define SD_WAV_PATH_ALT "/SD:VOICEDBG.WAV"

static const struct device *ipm_dev;

static volatile bool audio_ready = false;

static void ipm_rx_cb(const struct device *dev, void *ctx,
		      uint32_t id, volatile void *data)
{
	ARG_UNUSED(dev);
	ARG_UNUSED(ctx);

	if (id == IPM_ID_LOG) {
		LOG_INF("%s", (const char *)data);
	} else if (id == IPM_ID_DONE) {
		audio_ready = true;
	}
}

/*
 * Build a 44-byte standard WAV header for 16kHz, 16-bit, mono PCM.
 * data_bytes is the number of raw PCM bytes that follow.
 */
static void build_wav_header(uint8_t *hdr, uint32_t data_bytes)
{
	uint32_t riff_size   = 36 + data_bytes;
	uint32_t sample_rate = AUDIO_SAMPLE_RATE;
	uint32_t byte_rate   = AUDIO_SAMPLE_RATE * AUDIO_CHANNELS * (AUDIO_BITS / 8);
	uint16_t audio_fmt   = 1;     /* PCM */
	uint16_t channels    = AUDIO_CHANNELS;
	uint16_t block_align = AUDIO_CHANNELS * (AUDIO_BITS / 8);
	uint16_t bits        = AUDIO_BITS;
	uint32_t fmt_size    = 16;

	memcpy(hdr +  0, "RIFF", 4);  memcpy(hdr +  4, &riff_size,   4);
	memcpy(hdr +  8, "WAVE", 4);  memcpy(hdr + 12, "fmt ", 4);
	memcpy(hdr + 16, &fmt_size,   4);  memcpy(hdr + 20, &audio_fmt,   2);
	memcpy(hdr + 22, &channels,   2);  memcpy(hdr + 24, &sample_rate, 4);
	memcpy(hdr + 28, &byte_rate,  4);  memcpy(hdr + 32, &block_align, 2);
	memcpy(hdr + 34, &bits,       2);  memcpy(hdr + 36, "data", 4);
	memcpy(hdr + 40, &data_bytes, 4);
}

/*
 * Send the PSRAM audio buffer to the voice service as a WAV file.
 *
 * PSRAM layout: stereo-interleaved 16-bit PCM at 16kHz.
 *   [L0, R0, L1, R1, ...]  — L = mic (left), R = zeros (PDM mono mic)
 * We strip the right channel and send mono left-channel PCM only.
 *
 * Assumes log_audio_samples() has already been called (invalidates cache).
 */
#define WAV_HEADER_LEN   44
/* Must not exceed CONFIG_MBEDTLS_SSL_MAX_CONTENT_LEN (4096). */
#define PCM_CHUNK_BYTES  4096

static int send_wav_header_ws(uint32_t mono_bytes)
{
	uint8_t hdr[WAV_HEADER_LEN];

	build_wav_header(hdr, mono_bytes);
	if (ws_send_binary(hdr, WAV_HEADER_LEN) < 0) {
		LOG_ERR("[C0] WAV header send failed");
		return -1;
	}

	return 0;
}

static void send_audio_as_wav(void)
{
	const struct audio_shared *shdr = (const struct audio_shared *)audio_buf;

	/* Invalidate the header first so we can read byte_count, then the PCM. */
	sys_cache_data_invd_range((void *)audio_buf, sizeof(struct audio_shared));
	uint32_t mono_bytes = shdr->byte_count;
	sys_cache_data_invd_range((void *)shdr->pcm, mono_bytes);

	/* Debug: write mono PCM to SD card as a WAV for offline inspection. */
	// sd_wav_write("/SD:/PROCREC.WAV", shdr);

	if (!ws_is_connected()) {
		LOG_WRN("[C0] WS not connected — dropping audio (%u bytes)",
			mono_bytes);
		return;
	}

	if (send_wav_header_ws(mono_bytes) < 0) {
		return;
	}

	const uint8_t *pcm = (const uint8_t *)shdr->pcm;
	uint32_t remaining = mono_bytes;

	while (remaining > 0) {
		uint32_t chunk = remaining > PCM_CHUNK_BYTES ? PCM_CHUNK_BYTES : remaining;

		if (ws_send_binary(pcm, chunk) < 0) {
			LOG_ERR("[C0] PCM chunk send failed");
			return;
		}
		pcm += chunk;
		remaining -= chunk;
	}

	if (ws_send_text("{\"type\":\"end_audio\"}") < 0) {
		LOG_ERR("[C0] end_audio send failed");
		return;
	}

	LOG_INF("[C0] sent %u bytes WAV mono to server", mono_bytes);
}

int main(void)
{
	LOG_INF("[C0] procpu starting");

	k_sleep(K_MSEC(500));
	storage_init();
	wifi_init();

	ipm_dev = DEVICE_DT_GET(DT_NODELABEL(ipm0));
	if (!device_is_ready(ipm_dev)) {
		LOG_ERR("[C0] IPM not ready");
		return -1;
	}
	ipm_register_callback(ipm_dev, ipm_rx_cb, NULL);

	/* Tell appcpu the exact PSRAM address of the shared audio buffer.
	 * appcpu registers its IPM callback before its startup sleep, so it
	 * will be ready to receive this by the time we send it here. */
	uint32_t buf_addr = (uint32_t)(uintptr_t)audio_psram_buf;
	ipm_send(ipm_dev, 1, IPM_ID_BUFADDR, &buf_addr, sizeof(buf_addr));
	LOG_INF("[C0] sent audio buf addr 0x%08X to appcpu", buf_addr);

	uint32_t play_addr = (uint32_t)(uintptr_t)play_buf;
	ipm_send(ipm_dev, 1, IPM_ID_PLAYBUFADDR, &play_addr, sizeof(play_addr));
	LOG_INF("[C0] sent play buf addr 0x%08X to appcpu", play_addr);

	if (button_init(ipm_dev) < 0) {
		return -1;
	}

	gpio_pin_configure_dt(&led, GPIO_OUTPUT_INACTIVE);

	net_thread_start();

	LOG_INF("[C0] ready — hold BOOT button to record; "
		"connect WiFi via: wifi connect -s <SSID> -p <PSK> -k 1");

	uint32_t blink_ticks = 0;

	while (1) {
		if (audio_ready) {
			audio_ready = false;
			LOG_INF("[C0] audio ready in PSRAM");
			send_audio_as_wav();
		}

		if (++blink_ticks >= 25) {
			gpio_pin_toggle_dt(&led);
			blink_ticks = 0;
		}

		k_sleep(K_MSEC(20));
	}

	return 0;
}
```

## src/audio.c
```c
#include "audio.h"
#include "audio_shared.h"

#include <zephyr/kernel.h>
#include <zephyr/cache.h>
#include <zephyr/logging/log.h>
#include <stdint.h>
#include <math.h>

LOG_MODULE_DECLARE(procpu, LOG_LEVEL_DBG);

/*
 * Shared audio record buffer in PSRAM.
 * appcpu writes PCM here during recording; procpu reads after IPM_ID_DONE.
 */
uint8_t audio_psram_buf[AUDIO_BUF_MAX]
	__attribute__((section(".ext_ram.bss"))) __attribute__((aligned(64)));

const uint8_t * const audio_buf = audio_psram_buf;

/*
 * Shared audio playback buffer in PSRAM.
 * procpu writes WAV here (struct play_shared header + wav[]); appcpu reads
 * and plays after IPM_ID_PLAY signal.
 */
uint8_t play_psram_buf[PLAY_BUF_MAX]
	__attribute__((section(".ext_ram.bss"))) __attribute__((aligned(64)));

struct play_shared * const play_buf = (struct play_shared *)play_psram_buf;

void log_audio_samples(uint32_t byte_count)
{
	if (byte_count < 16) {
		LOG_WRN("[C0] too few bytes to inspect (%u)", byte_count);
		return;
	}

	/* Invalidate procpu's cache for this region before reading,
	 * ensuring we see the data appcpu flushed from its cache. */
	sys_cache_data_invd_range((void *)audio_buf, byte_count);

	/* PCM is 16-bit signed little-endian, stereo-interleaved.
	 * Even indices = left channel (mic), odd = right (zeros). */
	const int16_t *samples = (const int16_t *)audio_buf;
	uint32_t       n       = (byte_count / 2 < 8) ? byte_count / 2 : 8;

	LOG_INF("[C0] first %u PCM samples from PSRAM:", n);
	for (uint32_t i = 0; i < n; i++) {
		LOG_INF("  [%u] %d", i, samples[i]);
	}

	/* RMS² over first 256 samples (includes startup transients) */
	uint32_t count  = (byte_count / 2 < 256) ? byte_count / 2 : 256;
	int64_t  sum_sq = 0;

	for (uint32_t i = 0; i < count; i++) {
		int32_t s = samples[i];
		sum_sq += s * s;
	}
	LOG_INF("[C0] RMS² first  256 samples: %u", (uint32_t)(sum_sq / count));

	/* RMS² over 256 samples from the MIDDLE of the recording.
	 * If this is much lower than the first-256 RMS², the high RMS above
	 * is just startup transients — not ongoing noise. */
	uint32_t total  = byte_count / 2;               /* int16_t count   */
	uint32_t mid    = (total / 2 > 128) ? total / 2 - 128 : 0;
	uint32_t m_count = (total - mid < 256) ? total - mid : 256;
	int64_t  m_sq   = 0;

	/* Show 4 mid-point samples */
	LOG_INF("[C0] mid-point samples (idx %u+):", mid);
	for (uint32_t i = mid; i < mid + 4 && i < total; i++) {
		LOG_INF("  [%u] %d", i, samples[i]);
	}

	/* Mid-point RMS² for combined stereo */
	for (uint32_t i = mid; i < mid + m_count; i++) {
		int32_t s = samples[i];
		m_sq += s * s;
	}
	LOG_INF("[C0] RMS² middle 256 samples (combined): %u",
		(uint32_t)(m_sq / m_count));

	/* Separate L/R channel RMS² over the same mid-point window.
	 * Even stereo indices = L (mic data), odd = R (should be ~0 with pull-down).
	 * High R-RMS → floating DATA line during CLK HIGH (mono mic tri-states).
	 * Low R-RMS + any L-RMS → mic wired correctly, use only L channel. */
	int64_t l_sq = 0, r_sq = 0;
	uint32_t lr_count = 0;

	for (uint32_t i = mid; i < mid + m_count; i++) {
		int32_t s = samples[i];
		if (i % 2 == 0) { l_sq += s * s; } else { r_sq += s * s; }
		lr_count++;
	}
	uint32_t half = lr_count / 2;

	LOG_INF("[C0] L-ch RMS²=%u  R-ch RMS²=%u  (mid window, %u stereo pairs)",
		(uint32_t)(l_sq / (half ? half : 1)),
		(uint32_t)(r_sq / (half ? half : 1)),
		half);

	/* L/R correlation over the same mid window.
	 * corr ~ +1: channels are duplicates
	 * corr ~  0: unrelated (likely noise/floating)
	 * corr ~ -1: inverted copies
	 */
	if (half >= 8) {
		int64_t lr_dot = 0;
		int64_t ll_dot = 0;
		int64_t rr_dot = 0;

		for (uint32_t p = 0; p < half; p++) {
			uint32_t base = (mid + p) * 2;
			int32_t l = samples[base];
			int32_t r = samples[base + 1];
			lr_dot += (int64_t)l * (int64_t)r;
			ll_dot += (int64_t)l * (int64_t)l;
			rr_dot += (int64_t)r * (int64_t)r;
		}

		double denom = 1.0;
		if (ll_dot > 0 && rr_dot > 0) {
			denom = sqrt((double)ll_dot) * sqrt((double)rr_dot);
		}
		double corr = (double)lr_dot / denom;

		LOG_INF("[C0] L/R corr (mid window): %.3f", corr);
	}

	/* Stereo: 16kHz × 2 bytes/sample × 2 channels = 64000 bytes/s */
	LOG_INF("[C0] audio_byte_cnt=%u  (%.2f s at 16kHz 16-bit stereo)",
		byte_count,
		(double)byte_count / (16000.0 * 2.0 * 2.0));
}
```

## src/audio.h
```c
#pragma once

#include <stdint.h>
#include "audio_shared.h"

/*
 * Shared PSRAM audio record buffer — written by appcpu, read by procpu.
 * Both cores access it via direct pointer (data cache, no DMA).
 *
 * The buffer is allocated in procpu's .ext_ram.bss (linker-managed PSRAM).
 * appcpu receives the runtime address via IPM_ID_BUFADDR at boot.
 * See embedded/common/audio_shared.h for the buffer layout (header + PCM).
 */
extern uint8_t audio_psram_buf[];
extern const uint8_t * const audio_buf;

/*
 * Shared PSRAM playback buffer — written by procpu (WebSocket RX),
 * read by appcpu (I2S TX via MAX98357A).
 *
 * procpu writes a struct play_shared header + WAV bytes, flushes the cache,
 * then sends IPM_ID_PLAY to appcpu.  appcpu receives the runtime address
 * at boot via IPM_ID_PLAYBUFADDR.
 * See embedded/common/audio_shared.h for the struct play_shared layout.
 *
 * play_buf is a typed alias over play_psram_buf, signalling that procpu owns
 * writes to this buffer (contrast: audio_buf is const — procpu only reads it).
 */
extern uint8_t play_psram_buf[];
extern struct play_shared * const play_buf;

/* Log the first 8 PCM samples and an RMS² sanity value from PSRAM. */
void log_audio_samples(uint32_t byte_count);
```

## src/button.c
```c
#include "button.h"

#include <zephyr/kernel.h>
#include <zephyr/logging/log.h>
#include <zephyr/drivers/gpio.h>
#include <zephyr/drivers/ipm.h>

LOG_MODULE_DECLARE(procpu, LOG_LEVEL_DBG);

#define IPM_ID_CMD  1U
#define CMD_STOP    0U
#define CMD_START   1U

#define BTN_NODE DT_ALIAS(sw0)
static const struct gpio_dt_spec btn = GPIO_DT_SPEC_GET(BTN_NODE, gpios);

static struct gpio_callback  btn_cb_data;
static struct k_work         btn_work;
static const struct device  *ipm;

static volatile bool recording = false;

static int send_cmd(uint8_t cmd)
{
	/*
	 * IPM mailbox is a single shared slot (no queue). Under heavy appcpu
	 * logging, one-shot sends can fail transiently. Retry briefly so START/STOP
	 * button edges are not lost.
	 */
	for (int attempt = 0; attempt < 20; attempt++) {
		int ret = ipm_send(ipm, 1, IPM_ID_CMD, &cmd, sizeof(cmd));
		if (ret == 0) {
			return 0;
		}
		k_sleep(K_MSEC(5));
	}

	return -EIO;
}

static void btn_work_handler(struct k_work *work)
{
	ARG_UNUSED(work);

	bool pressed = (gpio_pin_get_dt(&btn) == 1);

	if (pressed && !recording) {
		recording = true;
		LOG_INF("[C0] button pressed — sending START to appcpu");
		if (send_cmd(CMD_START) < 0) {
			LOG_WRN("[C0] START send failed");
		}
	} else if (!pressed && recording) {
		recording = false;
		LOG_INF("[C0] button released — sending STOP to appcpu");
		if (send_cmd(CMD_STOP) < 0) {
			LOG_WRN("[C0] STOP send failed");
		}
	}
}

static void btn_isr(const struct device *dev, struct gpio_callback *cb,
		    uint32_t pins)
{
	ARG_UNUSED(dev);
	ARG_UNUSED(cb);
	ARG_UNUSED(pins);

	k_work_submit(&btn_work);
}

int button_init(const struct device *ipm_dev)
{
	ipm = ipm_dev;

	if (!gpio_is_ready_dt(&btn)) {
		LOG_ERR("[C0] BOOT button GPIO not ready");
		return -ENODEV;
	}

	gpio_pin_configure_dt(&btn, GPIO_INPUT);
	k_work_init(&btn_work, btn_work_handler);
	gpio_init_callback(&btn_cb_data, btn_isr, BIT(btn.pin));
	gpio_add_callback(btn.port, &btn_cb_data);
	gpio_pin_interrupt_configure_dt(&btn, GPIO_INT_EDGE_BOTH);

	return 0;
}
```

## src/button.h
```c
#pragma once

#include <zephyr/drivers/ipm.h>

/*
 * Initialise the BOOT button (GPIO0) with interrupt-driven edge detection.
 * Both press and release are handled via a k_work item in the system workqueue.
 * ipm_dev is used to send CMD_START / CMD_STOP to appcpu.
 */
int button_init(const struct device *ipm_dev);
```

## src/server_cert.h
```c
#pragma once

/*
 * Pinned TLS certificate for vulcan (CN=vulcan.local, self-signed, RSA 2048).
 * Valid 2026-03-06 → 2036-03-03.
 *
 * To regenerate after renewing the nginx certificate:
 *   echo | openssl s_client -connect localhost:443 2>/dev/null \
 *     | openssl x509 -outform PEM
 * Then replace the base64 lines below.
 */
static const char server_ca_cert[] =
    "-----BEGIN CERTIFICATE-----\n"
    "MIIC9jCCAd6gAwIBAgIUYbMG4Ft3V/YL9vgLaVm7bcin5UIwDQYJKoZIhvcNAQEL\n"
    "BQAwFzEVMBMGA1UEAwwMdnVsY2FuLmxvY2FsMB4XDTI2MDMwNjA0NDM0OVoXDTM2\n"
    "MDMwMzA0NDM0OVowFzEVMBMGA1UEAwwMdnVsY2FuLmxvY2FsMIIBIjANBgkqhkiG\n"
    "9w0BAQEFAAOCAQ8AMIIBCgKCAQEAlixQrPFelNlWO488zPvy5yd5bg5EXyNpA2yP\n"
    "9n5AZaKTUxzmEuanWBZzHShGr5SzPKJhI+BCGNoXSHbPVnSQ/nb9pvskAbTm/XMT\n"
    "+17VHMTjImOhka5c39XLXyniyVKMutyRFxsVthBEldT28Hb8kGf+/2qOXIy5jsvC\n"
    "L311fTqD3PVapmEkbHl8DoXpCEg/wZk4hFSIDL7+5U91zPqqPBQHmXt4A6j6ajtm\n"
    "6zB7egxy8d3sxlvJ0AML2rsJfhrQro7iUjjGvEocb15/SZ9tsYveTgAsnKxeK7Ar\n"
    "GEthNJRHT8oodePUCo1my3Q0wB3jgxQHFgp+RI54d7NMgfCrDQIDAQABozowODAX\n"
    "BgNVHREEEDAOggx2dWxjYW4ubG9jYWwwHQYDVR0OBBYEFG8TCpop4U0jqb/eEozk\n"
    "e/i/1C5yMA0GCSqGSIb3DQEBCwUAA4IBAQAOWDQUbgLj5KvvLIuJ00FE4v+39xOo\n"
    "NQO5IYyFDl9Oj13KMVVYIR9lDmphHJvP8m3dAFr4/0Ml3t6dN45wOBKq5CBmlveU\n"
    "bY3X72BsHaDf/SEX/KK7Q3DJvyMlWMSWLlGq+7gdnktBoDmHTmPO8Vh0sqGCZhlO\n"
    "UaR2ZxDPdFoaNdYI6FB+m3xyn9l6pJLzB7XHGYvnHKgEQXwSDQjA9ZhIvaWIIV0F\n"
    "FtUvVBpDyKoMpckt327TfgZqV1hSsgg2oc/mskfUkBPw++nmySV+nNaygZCsDBao\n"
    "bSsZIFi/2MtoJW0IzmOyJgv5b7pk1ZTeCJPXMVVK0IHuTl9JNwa3UBS4\n"
    "-----END CERTIFICATE-----\n";
```

## src/storage.c
```c
#include <zephyr/kernel.h>
#include <zephyr/logging/log.h>
#include <zephyr/shell/shell.h>

#include "storage.h"

LOG_MODULE_DECLARE(procpu, LOG_LEVEL_DBG);

#ifdef CONFIG_FILE_SYSTEM_LITTLEFS

#include <zephyr/fs/fs.h>
#include <zephyr/fs/littlefs.h>
#include <zephyr/storage/flash_map.h>
#include <string.h>

#define LFS_MOUNT_POINT "/lfs"
#define SSID_PATH       "/lfs/ssid"
#define PASS_PATH       "/lfs/pass"
#define MAX_SSID_LEN    64
#define MAX_PASS_LEN    64

FS_LITTLEFS_DECLARE_DEFAULT_CONFIG(lfs_data);

static struct fs_mount_t lfs_mnt = {
	.type        = FS_LITTLEFS,
	.fs_data     = &lfs_data,
	.mnt_point   = LFS_MOUNT_POINT,
	.storage_dev = (void *)FIXED_PARTITION_ID(storage_partition),
};

/* ── internal helpers ───────────────────────────────────────────────────── */

static int write_file(const char *path, const char *data)
{
	struct fs_file_t f;

	fs_file_t_init(&f);
	int ret = fs_open(&f, path, FS_O_CREATE | FS_O_WRITE | FS_O_TRUNC);

	if (ret < 0) {
		return ret;
	}
	ssize_t n = fs_write(&f, data, strlen(data));

	fs_close(&f);
	return n < 0 ? (int)n : 0;
}

static int read_file(const char *path, char *buf, size_t len)
{
	struct fs_file_t f;

	fs_file_t_init(&f);
	int ret = fs_open(&f, path, FS_O_READ);

	if (ret < 0) {
		return ret;
	}
	ssize_t n = fs_read(&f, buf, len - 1);

	fs_close(&f);
	if (n < 0) {
		return (int)n;
	}
	buf[n] = '\0';
	return 0;
}

/* ── public API ─────────────────────────────────────────────────────────── */

int storage_init(void)
{
	int ret = fs_mount(&lfs_mnt);

	if (ret < 0) {
		LOG_ERR("[C0] LittleFS mount failed: %d", ret);
		return ret;
	}
	LOG_INF("[C0] LittleFS mounted at %s", LFS_MOUNT_POINT);
	return 0;
}

int storage_wifi_creds_read(char *ssid, size_t ssid_len, char *pass, size_t pass_len)
{
	int ret = read_file(SSID_PATH, ssid, ssid_len);

	if (ret < 0) {
		return ret;
	}
	return read_file(PASS_PATH, pass, pass_len);
}

/* ── shell commands ─────────────────────────────────────────────────────── */

static int cmd_set(const struct shell *sh, size_t argc, char **argv)
{
	int ret = write_file(SSID_PATH, argv[1]);

	if (ret < 0) {
		shell_error(sh, "failed to write SSID: %d", ret);
		return ret;
	}
	ret = write_file(PASS_PATH, argv[2]);
	if (ret < 0) {
		shell_error(sh, "failed to write password: %d", ret);
		return ret;
	}
	shell_print(sh, "credentials saved");
	return 0;
}

static int cmd_show(const struct shell *sh, size_t argc, char **argv)
{
	ARG_UNUSED(argc);
	ARG_UNUSED(argv);

	char ssid[MAX_SSID_LEN] = {0};
	char pass[MAX_PASS_LEN] = {0};
	int ret;

	ret = read_file(SSID_PATH, ssid, sizeof(ssid));
	if (ret < 0) {
		shell_error(sh, "no SSID stored (%d)", ret);
		return ret;
	}
	ret = read_file(PASS_PATH, pass, sizeof(pass));
	if (ret < 0) {
		shell_error(sh, "no password stored (%d)", ret);
		return ret;
	}
	shell_print(sh, "ssid: %s", ssid);
	shell_print(sh, "pass: %.*s***", (int)(strlen(pass) > 2 ? 2 : 0), pass);
	return 0;
}

static int cmd_clear(const struct shell *sh, size_t argc, char **argv)
{
	ARG_UNUSED(argc);
	ARG_UNUSED(argv);

	fs_unlink(SSID_PATH);
	fs_unlink(PASS_PATH);
	shell_print(sh, "credentials cleared");
	return 0;
}

SHELL_STATIC_SUBCMD_SET_CREATE(wifi_creds_cmds,
	SHELL_CMD_ARG(set,   NULL, "<ssid> <pass>", cmd_set,   3, 0),
	SHELL_CMD_ARG(show,  NULL, "",              cmd_show,  1, 0),
	SHELL_CMD_ARG(clear, NULL, "",              cmd_clear, 1, 0),
	SHELL_SUBCMD_SET_END
);

SHELL_CMD_REGISTER(wifi_creds, &wifi_creds_cmds, "Manage WiFi credentials in LittleFS", NULL);

#else /* CONFIG_FILE_SYSTEM_LITTLEFS */

int storage_init(void)
{
	LOG_WRN("[C0] LittleFS not enabled — storage unavailable");
	return -ENOTSUP;
}

int storage_wifi_creds_read(char *ssid, size_t ssid_len, char *pass, size_t pass_len)
{
	ARG_UNUSED(ssid); ARG_UNUSED(ssid_len);
	ARG_UNUSED(pass); ARG_UNUSED(pass_len);
	return -ENOTSUP;
}

#endif /* CONFIG_FILE_SYSTEM_LITTLEFS */
```

## src/storage.h
```c
#ifndef STORAGE_H
#define STORAGE_H

#include <stddef.h>

int storage_init(void);
int storage_wifi_creds_read(char *ssid, size_t ssid_len, char *pass, size_t pass_len);

#endif /* STORAGE_H */
```

## src/websocket.c
```c
/*
 * websocket.c — TLS WebSocket client for procpu (Milestone 2)
 *
 * net_thread flow:
 *   wifi_wait_for_dhcp()          block until shell "wifi connect" completes
 *   tls_socket_connect()          DNS lookup + TLS handshake
 *   websocket_connect()           HTTP 101 upgrade → ws_fd
 *   ws_send_text(config_msg)      announce wav/16kHz capability
 *   recv_loop()                   log all server messages; break on error
 *   k_sleep(3s)                   back-off before retry
 *   if WiFi dropped → wifi_wait_for_dhcp() again
 *
 * TLS: the pinned server CA cert (server_cert.h) is loaded via
 * TLS_SEC_TAG_LIST.  Peer verification is set to NONE because the server
 * uses a self-signed certificate; proper chain validation will be added in
 * Milestone 8 (provisioning) once cert distribution is designed.
 *
 * The mbedTLS heap (60KB) is placed in PSRAM at link time via
 * CONFIG_MBEDTLS_HEAP_CUSTOM_SECTION.  The ESP32S3 linker script maps the
 * .mbedtls_heap section directly into .ext_ram.data (PSRAM), so TLS
 * allocations cost zero DRAM.
 */

#include <zephyr/kernel.h>
#include <zephyr/logging/log.h>
#include <zephyr/net/socket.h>
#include <zephyr/net/tls_credentials.h>
#include <zephyr/net/websocket.h>
#include <zephyr/net/http/client.h>
#include <errno.h>
#include <stdio.h>
#include <string.h>

#include <zephyr/drivers/ipm.h>
#include <zephyr/cache.h>
#include "wifi.h"
#include "websocket.h"
#include "server_cert.h"
#include "ipm_ids.h"
#include "audio.h"
#include "audio_shared.h"

LOG_MODULE_DECLARE(procpu, LOG_LEVEL_DBG);

/* TLS credential tag for the pinned server CA certificate */
#define VOICE_CA_TAG  1

/* ── Thread ──────────────────────────────────────────────────────────────── */
#define NET_STACK_SIZE  16384
#define NET_THREAD_PRIO 5

/*
 * Place the net_thread stack in PSRAM (.ext_ram.bss) instead of DRAM
 * (.noinit.stacks).  K_THREAD_STACK_DEFINE would put 16KB in DRAM, which is
 * enough to push the DRAM segment over budget when mbedTLS is enabled.
 * Xtensa requires 16-byte stack alignment; no MPU guard page is needed since
 * CONFIG_USERSPACE is not enabled.
 */
static uint8_t net_stack_mem[NET_STACK_SIZE]
	__attribute__((section(".ext_ram.bss"))) __aligned(16);
static struct k_thread net_thread_data;

/* ── Shared state ────────────────────────────────────────────────────────── */
static volatile int  ws_fd      = -1;
static volatile bool connected;

/* IPM device for signalling appcpu to play received TTS audio */
static const struct device *play_ipm;

/* ── Buffers (stack-allocated inside net_thread — fits in 16KB) ─────────── */
#define HTTP_BUF_SIZE  512   /* HTTP 101 upgrade response */
#define RECV_BUF_SIZE  2048  /* incoming WebSocket frames  */

/* Config message sent immediately after the WebSocket upgrade */
#define CONFIG_MSG \
	"{\"type\":\"config\",\"tts\":true," \
	"\"audio_format\":\"wav\",\"sample_rate\":16000}"

/*
 * Inbound TTS WAV frames are accumulated into play_buf (PSRAM, defined in
 * audio.c).  Chunks arrive via websocket_recv_msg() until remaining == 0,
 * at which point procpu flushes the cache and signals appcpu via IPM_ID_PLAY.
 */
static size_t rx_wav_len;
static int    rx_wav_idx;  /* sentence counter — increments across sessions */


/* ── TLS socket + TCP connect ────────────────────────────────────────────── */

static int tls_socket_connect(void)
{
	char port_str[6];
	struct zsock_addrinfo hints = {
		.ai_family   = AF_INET,
		.ai_socktype = SOCK_STREAM,
	};
	struct zsock_addrinfo *res = NULL;

	snprintf(port_str, sizeof(port_str), "%d", VOICE_SERVER_PORT);

	int ret = zsock_getaddrinfo(VOICE_SERVER_HOST, port_str, &hints, &res);

	if (ret != 0) {
		LOG_ERR("[C0] DNS lookup for %s failed: %d",
			VOICE_SERVER_HOST, ret);
		return -EHOSTUNREACH;
	}

	int sock = zsock_socket(AF_INET, SOCK_STREAM, IPPROTO_TLS_1_2);

	if (sock < 0) {
		LOG_ERR("[C0] socket() failed: %d", errno);
		zsock_freeaddrinfo(res);
		return -errno;
	}

	/* Associate the pinned CA cert with this socket.
	 * tls_check_credentials() validates the cert at setsockopt time;
	 * the 60KB mbedTLS heap in PSRAM provides the memory for parsing. */
	static const sec_tag_t sec_tags[] = { VOICE_CA_TAG };

	ret = zsock_setsockopt(sock, SOL_TLS, TLS_SEC_TAG_LIST,
			       sec_tags, sizeof(sec_tags));
	if (ret < 0) {
		LOG_ERR("[C0] setsockopt TLS_SEC_TAG_LIST failed: %d", errno);
		zsock_close(sock);
		zsock_freeaddrinfo(res);
		return -errno;
	}
	LOG_INF("[C0] setsockopt TLS_SEC_TAG_LIST OK");

	/* Skip chain validation — cert is self-signed; we pin it instead.
	 * Proper REQUIRED validation deferred to Milestone 8. */
	int verify = TLS_PEER_VERIFY_NONE;

	ret = zsock_setsockopt(sock, SOL_TLS, TLS_PEER_VERIFY,
			       &verify, sizeof(verify));
	if (ret < 0) {
		LOG_ERR("[C0] setsockopt TLS_PEER_VERIFY failed: %d", errno);
		zsock_close(sock);
		zsock_freeaddrinfo(res);
		return -errno;
	}
	LOG_INF("[C0] setsockopt TLS_PEER_VERIFY OK");

	/* TLS hostname for SNI — must match CN/SAN in the pinned cert. */
	ret = zsock_setsockopt(sock, SOL_TLS, TLS_HOSTNAME,
			       VOICE_SERVER_TLS_HOST,
			       strlen(VOICE_SERVER_TLS_HOST));
	if (ret < 0) {
		LOG_ERR("[C0] setsockopt TLS_HOSTNAME failed: %d", errno);
		zsock_close(sock);
		zsock_freeaddrinfo(res);
		return -errno;
	}
	LOG_INF("[C0] setsockopt TLS_HOSTNAME OK");

	/* Verify cert is still in credential store before connecting.
	 * Use a tiny buffer: -ENOENT → missing, -EFBIG → present (expected). */
	{
		uint8_t probe = 0;
		size_t probe_len = sizeof(probe);
		int cred_ret = tls_credential_get(VOICE_CA_TAG,
						  TLS_CREDENTIAL_CA_CERTIFICATE,
						  &probe, &probe_len);

		if (cred_ret == -ENOENT) {
			LOG_ERR("[C0] CA cert (tag %d) not in store — "
				"re-adding now", VOICE_CA_TAG);
			cred_ret = tls_credential_add(
				VOICE_CA_TAG,
				TLS_CREDENTIAL_CA_CERTIFICATE,
				server_ca_cert,
				sizeof(server_ca_cert));
			if (cred_ret < 0) {
				LOG_ERR("[C0] re-add failed: %d", cred_ret);
				zsock_close(sock);
				zsock_freeaddrinfo(res);
				return cred_ret;
			}
			LOG_INF("[C0] CA cert re-added (tag %d)", VOICE_CA_TAG);
		} else {
			LOG_INF("[C0] CA cert (tag %d) present in store", VOICE_CA_TAG);
		}
	}

	LOG_INF("[C0] Connecting to %s:%d (TLS)...",
		VOICE_SERVER_HOST, VOICE_SERVER_PORT);

	ret = zsock_connect(sock, res->ai_addr, res->ai_addrlen);
	zsock_freeaddrinfo(res);

	if (ret < 0) {
		LOG_ERR("[C0] connect() failed: %d", errno);
		zsock_close(sock);
		return -errno;
	}

	LOG_INF("[C0] TLS handshake complete");
	return sock;
}

/* ── WebSocket upgrade + recv loop ──────────────────────────────────────── */

static int ws_connect_and_run(void)
{
	int tcp_sock = tls_socket_connect();

	if (tcp_sock < 0) {
		return tcp_sock;
	}

	uint8_t http_buf[HTTP_BUF_SIZE];
	struct websocket_request req = {
		.host        = VOICE_SERVER_HOST,
		.url         = VOICE_SERVER_PATH,
		.cb          = NULL,
		.tmp_buf     = http_buf,
		.tmp_buf_len = sizeof(http_buf),
	};

	/* websocket_connect() takes ownership of tcp_sock */
	int wfd = websocket_connect(tcp_sock, &req, 5000, NULL);

	if (wfd < 0) {
		LOG_ERR("[C0] WebSocket upgrade failed: %d", wfd);
		zsock_close(tcp_sock);
		return wfd;
	}

	ws_fd     = wfd;
	connected = true;
	LOG_INF("[C0] WebSocket open — wss://%s%s",
		VOICE_SERVER_HOST, VOICE_SERVER_PATH);

	/* Announce audio format so the server parses WAV instead of webm */
	ws_send_text(CONFIG_MSG);

	/* ── Receive loop ─────────────────────────────────────────────────── */
	uint8_t  buf[RECV_BUF_SIZE];
	uint32_t msg_type;
	uint64_t remaining;

	rx_wav_len = 0;  /* reset accumulator for this session */

	while (1) {
		int ret = websocket_recv_msg(wfd, buf, sizeof(buf) - 1,
					     &msg_type, &remaining,
					     500);

		if (ret == -EAGAIN || ret == -ETIMEDOUT) {
			/* Timeout — nothing received, keep looping */
			continue;
		}

		if (ret < 0) {
			LOG_ERR("[C0] WS recv error: %d", ret);
			break;
		}

		if (msg_type & WEBSOCKET_FLAG_CLOSE) {
			LOG_INF("[C0] WS close received");
			break;
		}

		if (msg_type & WEBSOCKET_FLAG_TEXT) {
			buf[ret] = '\0';
			LOG_INF("[C0] WS rx text: %s", (char *)buf);
		} else if (msg_type & WEBSOCKET_FLAG_BINARY) {
			/* Accumulate chunks into shared PSRAM playback buffer. */
			if (rx_wav_len + ret <= PLAY_DATA_MAX) {
				memcpy(play_buf->wav + rx_wav_len, buf, ret);
				rx_wav_len += ret;
			} else {
				LOG_ERR("[C0] RX WAV overflow (%zu + %d > %u) "
					"— dropping sentence %d",
					rx_wav_len, ret,
					PLAY_DATA_MAX, rx_wav_idx);
				rx_wav_len = 0;
			}

			LOG_DBG("[C0] WS rx binary chunk: %d bytes "
				"(accumulated: %zu, remaining: %lld)",
				ret, rx_wav_len, remaining);

			/* Frame complete — write header, flush PSRAM, signal appcpu. */
			if (remaining == 0 && rx_wav_len > 0) {
				play_buf->magic = PLAY_SHARED_MAGIC;
				play_buf->len   = (uint32_t)rx_wav_len;

				sys_cache_data_flush_range(
					play_buf,
					sizeof(struct play_shared) + rx_wav_len);

				LOG_INF("[C0] RX WAV %d: %zu bytes — signalling appcpu",
					rx_wav_idx++, rx_wav_len);

				uint8_t sig = 1U;
				int err = ipm_send(play_ipm, 1, IPM_ID_PLAY,
						   &sig, sizeof(sig));
				if (err < 0) {
					LOG_ERR("[C0] IPM play failed: %d", err);
				}

				rx_wav_len = 0;
			}
		}
	}

	ws_fd     = -1;
	connected = false;
	websocket_disconnect(wfd);
	/* websocket_disconnect only closes the WS fd; the underlying TLS socket
	 * (ctx->real_sock) is not closed by the websocket layer.  Close it
	 * explicitly so the single TLS context slot is freed before the next
	 * connect attempt. */
	zsock_close(tcp_sock);
	return -EIO;
}

/* ── net_thread ──────────────────────────────────────────────────────────── */

static void net_thread_fn(void *a, void *b, void *c)
{
	ARG_UNUSED(a);
	ARG_UNUSED(b);
	ARG_UNUSED(c);

	LOG_INF("[C0] net_thread started — waiting for WiFi + DHCP");

	while (1) {
		if (!wifi_is_connected()) {
			LOG_INF("[C0] Waiting for DHCP "
				"(connect via shell: wifi connect -s <SSID> "
				"-p <PSK> -k 1)");
			wifi_wait_for_dhcp();
		}

		int ret = ws_connect_and_run();

		LOG_WRN("[C0] WS session ended (%d), retrying in 3s...", ret);
		k_sleep(K_SECONDS(3));
	}
}

/* ── Public API ──────────────────────────────────────────────────────────── */

void net_thread_start(void)
{
	play_ipm = DEVICE_DT_GET(DT_NODELABEL(ipm0));

	/* Register the pinned server CA cert once at startup.
	 * sizeof() includes the null terminator which mbedTLS expects. */
	int ret = tls_credential_add(VOICE_CA_TAG,
				     TLS_CREDENTIAL_CA_CERTIFICATE,
				     server_ca_cert,
				     sizeof(server_ca_cert));

	if (ret < 0 && ret != -EEXIST) {
		LOG_ERR("[C0] Failed to register CA cert: %d", ret);
	} else {
		LOG_INF("[C0] CA cert registered (tag %d)", VOICE_CA_TAG);
	}

	k_thread_create(&net_thread_data,
			(k_thread_stack_t *)net_stack_mem, NET_STACK_SIZE,
			net_thread_fn, NULL, NULL, NULL,
			NET_THREAD_PRIO, 0, K_NO_WAIT);
	k_thread_name_set(&net_thread_data, "net_thread");
}

bool ws_is_connected(void)
{
	return connected;
}

int ws_send_text(const char *msg)
{
	int fd = ws_fd;

	if (fd < 0) {
		return -ENOTCONN;
	}

	int ret = websocket_send_msg(fd,
				     (const uint8_t *)msg, strlen(msg),
				     WEBSOCKET_OPCODE_DATA_TEXT,
				     true, true, 5000);

	return ret < 0 ? ret : 0;
}

int ws_send_binary(const uint8_t *data, size_t len)
{
	int fd = ws_fd;

	if (fd < 0) {
		return -ENOTCONN;
	}

	int ret = websocket_send_msg(fd,
				     data, len,
				     WEBSOCKET_OPCODE_DATA_BINARY,
				     true, true, 5000);

	return ret < 0 ? ret : 0;
}
```

## src/websocket.h
```c
#pragma once

#include <stdint.h>
#include <stddef.h>
#include <stdbool.h>

/* ── Server coordinates ────────────────────────────────────────────────────
 * VOICE_SERVER_HOST     — DNS name used for TCP connection (resolved via router).
 * VOICE_SERVER_TLS_HOST — hostname sent in TLS SNI; must match the CN/SAN in
 *                         server_cert.h ("vulcan.local").
 * Override either in credentials.conf if your setup differs.
 */
#ifndef VOICE_SERVER_HOST
#define VOICE_SERVER_HOST      "vulcan"
#endif
#ifndef VOICE_SERVER_TLS_HOST
#define VOICE_SERVER_TLS_HOST  "vulcan.local"
#endif
#ifndef VOICE_SERVER_PORT
#define VOICE_SERVER_PORT  443
#endif
#define VOICE_SERVER_PATH  "/voice/converse"

/*
 * Spawn the net_thread.  Must be called after wifi_init().
 * The thread blocks on wifi_wait_for_dhcp(), then opens the WebSocket and
 * enters the receive loop.  Retries automatically on disconnect.
 */
void net_thread_start(void);

/* True while the WebSocket handshake has succeeded and the connection is open. */
bool ws_is_connected(void);

/*
 * Send a UTF-8 text frame.  Returns 0 on success, negative errno on failure.
 * Returns -ENOTCONN if the WebSocket is not currently open.
 */
int ws_send_text(const char *msg);

/*
 * Send a binary frame.  Returns 0 on success, negative errno on failure.
 * Returns -ENOTCONN if the WebSocket is not currently open.
 *
 * TODO (Milestone 3): called from main thread after audio capture —
 * add a mutex here if concurrent sends become a concern.
 */
int ws_send_binary(const uint8_t *data, size_t len);
```

## src/wifi.c
```c
/*
 * wifi.c — passive WiFi event listener for procpu
 *
 * Does NOT initiate WiFi connections.  The user connects via the Zephyr shell:
 *   uart:~$ wifi connect -s <SSID> -p <PSK> -k 1
 *
 * On successful DHCP assignment, posts dhcp_sem to unblock net_thread.
 * On disconnect, resets dhcp_sem so net_thread waits again on reconnect.
 */

#include <zephyr/kernel.h>
#include <zephyr/logging/log.h>
#include <zephyr/net/net_mgmt.h>
#include <zephyr/net/net_event.h>
#include <zephyr/net/wifi_mgmt.h>

#include "wifi.h"

LOG_MODULE_DECLARE(procpu, LOG_LEVEL_DBG);

static K_SEM_DEFINE(dhcp_sem, 0, 1);
static volatile bool wifi_connected;

static struct net_mgmt_event_callback wifi_cb;
static struct net_mgmt_event_callback dhcp_cb;

static void wifi_event_handler(struct net_mgmt_event_callback *cb,
			       uint64_t mgmt_event, struct net_if *iface)
{
	ARG_UNUSED(cb);
	ARG_UNUSED(iface);

	if (mgmt_event == NET_EVENT_WIFI_CONNECT_RESULT) {
		const struct wifi_status *status =
			(const struct wifi_status *)cb->info;

		if (status && status->status == 0) {
			LOG_INF("[C0] WiFi associated — waiting for DHCP");
			wifi_connected = true;
		} else {
			LOG_WRN("[C0] WiFi association failed: %d",
				status ? status->status : -1);
		}
	} else if (mgmt_event == NET_EVENT_WIFI_DISCONNECT_RESULT) {
		LOG_INF("[C0] WiFi disconnected");
		wifi_connected = false;
		/* Reset so net_thread blocks on next wifi_wait_for_dhcp() */
		k_sem_reset(&dhcp_sem);
	}
}

static void dhcp_event_handler(struct net_mgmt_event_callback *cb,
			       uint64_t mgmt_event, struct net_if *iface)
{
	ARG_UNUSED(cb);
	ARG_UNUSED(iface);

	if (mgmt_event == NET_EVENT_IPV4_DHCP_BOUND) {
		LOG_INF("[C0] DHCP bound — IP assigned, WebSocket will connect");
		k_sem_give(&dhcp_sem);
	}
}

void wifi_init(void)
{
	net_mgmt_init_event_callback(
		&wifi_cb, wifi_event_handler,
		NET_EVENT_WIFI_CONNECT_RESULT | NET_EVENT_WIFI_DISCONNECT_RESULT);
	net_mgmt_add_event_callback(&wifi_cb);

	net_mgmt_init_event_callback(
		&dhcp_cb, dhcp_event_handler,
		NET_EVENT_IPV4_DHCP_BOUND);
	net_mgmt_add_event_callback(&dhcp_cb);

	LOG_INF("[C0] WiFi listener ready — connect via shell: "
		"wifi connect -s <SSID> -p <PSK> -k 1");
}

void wifi_wait_for_dhcp(void)
{
	k_sem_take(&dhcp_sem, K_FOREVER);
}

bool wifi_is_connected(void)
{
	return wifi_connected;
}
```

## src/wifi.h
```c
#pragma once

#include <stdbool.h>

/*
 * Register net_mgmt event listeners for WiFi connect/disconnect and DHCP bound.
 * Must be called before the network thread starts.
 */
void wifi_init(void);

/*
 * Block until NET_EVENT_IPV4_DHCP_BOUND fires (i.e. the user has run
 * "wifi connect" from the shell and DHCP has assigned an IP).  Returns
 * immediately if already bound.
 */
void wifi_wait_for_dhcp(void);

/*
 * Returns true while the WiFi interface is associated and has an IP.
 * Becomes false on NET_EVENT_WIFI_DISCONNECT_RESULT.
 */
bool wifi_is_connected(void);
```
